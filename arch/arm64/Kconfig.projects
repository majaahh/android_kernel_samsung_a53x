## arch/arm64/Kconfig.projects
```kconfig
# SPDX-License-Identifier: GPL-2.0-only
config SEC_A26XS_PROJECT
	default n
	bool "Samsung A26XS Project"
	help
	  Support for Samsung A26XS Project
```

## drivers/media/platform/exynos/camera/csi/Kconfig
```kconfig
config CSIS_V5_4
	bool "Use CSI H/W v5.4"
	depends on PABLO_V10_20_0
	help
	  csi version 5.4
```

## drivers/media/platform/exynos/camera/hardware/api/Kconfig
```kconfig
config MC_SCALER_V10_20
  bool "Use MC-SCALER H/W v10.20"
	depends on PABLO_V10_20_0
	default n
	help
	  use mc-scaler v10.20

config PDP_V3_1
  bool "Use PDP H/W v3.1"
	depends on PABLO_V10_20_0
  default n
  help
    use PDP v3.1

config YUVPP_V2_1
  bool "Use YUVPP H/W v2.1"
	depends on PABLO_V10_20_0
  default n
	help
	  use YUVPP v2.1

config TAA_V9_20
  bool "Use TAA H/W v9.20"
	depends on PABLO_V10_20_0
  default n
  help
    use 3AA v9.20

config ORBMCH_V2_1
	bool "Use ORBMCH H/W v2.1"
	depends on PABLO_V10_20_0
	default n
	help
	  use ORBMCH v2.1

config DNS_V1_20
  bool "Use DNS H/W v1.20"
	depends on PABLO_V10_20_0
  default n
  help
    use DNS v1.20

config ITP_V1_20
  bool "Use ITP H/W v1.20"
	depends on PABLO_V10_20_0
  default n
  help
    use ITP v1.0

config MCFP_V10_20
	bool "Use MCFP H/W v10.20"
	depends on PABLO_V10_20_0
	default n
	help
	  use MCFP v10.20
```

## drivers/media/platform/exynos/camera/ischain/Kconfig
```kconfig
config PABLO_V10_20_0
	bool "Use PABLO v10.20.0"
	depends on SOC_S5E8825
	default y
	select EXYNOS_DEVICE_MIPI_CSIS_VER4
	select CSIS_V5_4
	select CAMERA_CIS_SELECT
	select CAMERA_ACT_SELECT
	select CAMERA_FLASH_SELECT
	select CAMERA_PDP
	select CAMERA_DVFS_V2
	select CAMERA_MEM_V2
	select PDP_V3_1
	select TAA_V9_20
	select ORBMCH_V2_1
	select MCFP_V10_20
	select DNS_V1_20
	select ITP_V1_20
	select MC_SCALER_V10_20
	help
	  PABLO ISP version 10.20.0
```

## drivers/usb/typec/manager/Kconfig
```kconfig
#
# USB TypeC Manager driver
#

comment "USB TypeC Manager configs"

config USB_TYPEC_MANAGER_NOTIFIER
    tristate "USB TypeC Manager driver"
    help
    If you say yes here you will get support for
      USB TypeC Manager function

config IF_CB_MANAGER
    tristate "IF CallBack function Manager"
    default n
    help
    If you say yes here you will use if_cb_manager structure
    that makes functions to callback functions

config SBU_SWITCH_CONTROL
    bool "Support controlling SBU switch open/close"
    depends on IF_CB_MANAGER
    default n
    help
        If you say yes here you will use if_cb_manager function
        to control SBU switch (controlled by displayport TG)
        This config indicates that switch will be controlled
        manually by drivers, not automatically by FW or HW.
```

## drivers/vibrator/common/vib_info/Kconfig
```kconfig
config VIBRATOR_VIB_INFO
	tristate "The module for vibrator information"
	default n
	help
	  This module supports sysfs nodes for vibrator information.
	  supported functions are served for vibrator hal.
	  vibrator hal also can get intensities table by this module.
	  We recommend to use this module for all models.
```
